## main/Kconfig.projbuild
```kconfig
menu "Stock watchlist"

    config STOCK_REFRESH_INTERVAL_S
        int "Default quote refresh interval (seconds)"
        range 10 3600
        default 30
        help
            How often all quotes are fetched. Can be changed at run time with the
            "interval" console command.

endmenu
```
